// Copyright 2022 The Fuchsia Authors. All rights reserved.
// Use of this source code is governed by a BSD-style license that can be
// found in the LICENSE file.

/dts-v1/;

/ {
	compatible = "amlogic,a311d";
	#address-cells = <2>;
	#size-cells = <2>;

	clock-controller@ff63c000 {
		compatible = "amlogic,g12b-clk";
		reg = <0 0xff63c000 0 0x2000>, <0 0xff620000 0 0x10000>, <0 0xffd18000 0 0x1000>;

	};
}
