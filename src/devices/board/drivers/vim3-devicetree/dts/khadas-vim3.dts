// Copyright 2022 The Fuchsia Authors. All rights reserved.
// Use of this source code is governed by a BSD-style license that can be
// found in the LICENSE file.

/dts-v1/;

/include/ "src/devices/board/drivers/vim3-devicetree/dts/amlogic-a311d.dtsi";

#define ABC 123

/ {
	compatible = "khadas,vim3", "amlogic,a311d";

	model = "Khadas Vim3";

	sample {
		node = <ABC>;
	};
};
